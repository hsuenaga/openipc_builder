## backports/drivers/staging/r8188eu/Kconfig
```kconfig
# SPDX-License-Identifier: GPL-2.0
config BACKPORT_R8188EU
	tristate "Realtek RTL8188EU Wireless LAN NIC driver"
	depends on !R8188EU
	depends on WLAN && USB && BACKPORT_CFG80211
	depends on m
	depends on WIRELESS_EXT
	depends on WEXT_PRIV
	select BACKPORT_LIB80211
	select BACKPORT_LIB80211_CRYPT_WEP
	select BACKPORT_LIB80211_CRYPT_CCMP
	help
	This option adds support for the Realtek RTL8188EU chipset, used in USB
	devices such as the ASUS USB-N10 Nano. This newer driver is based on GitHub
	sources for version v4.1.4_6773.20130222, and contains modifications for
	newer kernel features. If built as a module, it will be called r8188eu.

if BACKPORT_R8188EU

config BACKPORT_88EU_AP_MODE
	bool "Realtek RTL8188EU AP mode"
	depends on !88EU_AP_MODE
	help
	This option enables Access Point mode. Unless you know that your system
	will never be used as an AP, or the target system has limited memory,
	"Y" should be selected.

endif
```

## backports/drivers/staging/rtl8723bs/Kconfig
```kconfig
# SPDX-License-Identifier: GPL-2.0
config BACKPORT_RTL8723BS
	tristate "Realtek RTL8723BS SDIO Wireless LAN NIC driver"
	depends on !RTL8723BS
	depends on WLAN && MMC && BACKPORT_CFG80211
	depends on m
	select BACKPORT_CFG80211_WEXT
	depends on CRYPTO_LIB_ARC4
	help
	This option enables support for BACKPORT_RTL8723BS SDIO drivers, such as
	the wifi found on the 1st gen Intel Compute Stick, the CHIP
	and many other Intel Atom and ARM based devices.
	If built as a module, it will be called r8723bs.
```

## devices/ssc338q_fpv_runcam-wifilinkjp/general/package/backport-mac80211/Config.in
```kconfig
comment "linux-backports needs a Linux kernel to be built"
	depends on !BR2_LINUX_KERNEL

config BACKPORT_MAC80211
	bool "backport-mac80211"
	depends on BR2_LINUX_KERNEL
	help
	  The linux-backports package includes many Linux drivers from
	  recent kernels, backported to older ones.

	  https://backports.wiki.kernel.org

if BACKPORT_MAC80211

choice
	prompt "Linux Backports version"
	default BACKPORT_MAC80211_5_15_X
	help
	  Select the highest version that supports your kernel version.

config BACKPORT_MAC80211_6_1_X
	bool "6.1.x (for kernels back to 4.11)"

config BACKPORT_MAC80211_5_15_X
	bool "5.15.x (for kernels back to 4.4)"

config BACKPORT_MAC80211_5_10_X
	bool "5.10.x (for kernels back to 3.10)"

endchoice

choice
	prompt "Linux kernel driver backports configuration"
	default BACKPORT_MAC80211_USE_DEFCONFIG

config BACKPORT_MAC80211_USE_DEFCONFIG
	bool "Using an in-tree defconfig file"

config BACKPORT_MAC80211_USE_CUSTOM_CONFIG
	bool "Using a custom (def)config file"

endchoice

config BACKPORT_MAC80211_DEFCONFIG
	string "Defconfig name"
	depends on BACKPORT_MAC80211_USE_DEFCONFIG
	help
	  Name of the backports defconfig file to use, without the
	  leading defconfig-. The defconfig is located in defconfigs/
	  directory in the backports tree.

config BACKPORT_MAC80211_CUSTOM_CONFIG_FILE
	string "Configuration file path"
	depends on BACKPORT_MAC80211_USE_CUSTOM_CONFIG
	help
	  Path to the backports configuration file

	  Note: this can be a defconfig file or a complete .config
	  file, which can later be saved back with make
	  linux-update-(def)config.

config BACKPORT_MAC80211_CONFIG_FRAGMENT_FILES
	string "Additional configuration fragment files"
	help
	  A space-separated list of configuration fragment files, that
	  will be merged to the main linux-backports configuration file.

endif # BACKPORT_MAC80211
```
