## backports/drivers/net/wireless/quantenna/qtnfmac/Kconfig
```kconfig
# SPDX-License-Identifier: GPL-2.0-only
config BACKPORT_QTNFMAC
	tristate
	depends on !QTNFMAC
	depends on BACKPORT_QTNFMAC_PCIE
	default m if BACKPORT_QTNFMAC_PCIE=m
	default y if BACKPORT_QTNFMAC_PCIE=y

config BACKPORT_QTNFMAC_PCIE
	tristate "Quantenna QSR1000/QSR2000/QSR10g PCIe support"
	depends on !QTNFMAC_PCIE
	default n
	depends on PCI && BACKPORT_CFG80211
	select BACKPORT_QTNFMAC
	depends on FW_LOADER
	depends on CRC32
	help
	  This option adds support for wireless adapters based on Quantenna
	  802.11ac QSR10g (aka Pearl) and QSR1000/QSR2000 (aka Topaz)
	  FullMAC chipsets running over PCIe.

	  If you choose to build it as a module, two modules will be built:
	  qtnfmac.ko and qtnfmac_pcie.ko.
```

## backports/drivers/net/wireless/realtek/rtw88/Kconfig
```kconfig
# SPDX-License-Identifier: GPL-2.0-only
menuconfig BACKPORT_RTW88
	tristate "Realtek 802.11ac wireless chips support"
	depends on !RTW88
	depends on BACKPORT_MAC80211
	help
	  This module adds support for mac80211-based wireless drivers that
	  enables Realtek IEEE 802.11ac wireless chipsets.

	  If you choose to build a module, it'll be called rtw88.

if BACKPORT_RTW88

config BACKPORT_RTW88_CORE
	tristate
	depends on !RTW88_CORE
	select WANT_DEV_COREDUMP

config BACKPORT_RTW88_PCI
	tristate
	depends on !RTW88_CORE

config BACKPORT_RTW88_SDIO
	tristate
	depends on !RTW88_SDIO

config BACKPORT_RTW88_USB
	tristate
	depends on !RTW88_USB

config BACKPORT_RTW88_8822B
	tristate
	depends on !RTW88_8822B

config BACKPORT_RTW88_8822C
	tristate
	depends on !RTW88_8822C

config BACKPORT_RTW88_8723X
	tristate
	depends on !RTW88_8723X

config BACKPORT_RTW88_8703B
	tristate
	depends on !RTW88_8703B
	select BACKPORT_RTW88_8723X

config BACKPORT_RTW88_8723D
	tristate
	depends on !RTW88_8723D
	select BACKPORT_RTW88_8723X

config BACKPORT_RTW88_8821C
	tristate
	depends on !RTW88_8821C

config BACKPORT_RTW88_88XXA
	tristate
	depends on !RTW88_88XXA

config BACKPORT_RTW88_8821A
	tristate
	depends on !RTW88_8821A
	select BACKPORT_RTW88_88XXA

config BACKPORT_RTW88_8812A
	tristate
	depends on !RTW88_8812A
	select BACKPORT_RTW88_88XXA

config BACKPORT_RTW88_8822BE
	tristate "Realtek 8822BE PCI wireless network adapter"
	depends on PCI
	depends on !RTW88_8822BE
	select BACKPORT_RTW88_CORE
	select BACKPORT_RTW88_PCI
	select BACKPORT_RTW88_8822B
	help
	  Select this option will enable support for 8822BE chipset

	  802.11ac PCIe wireless network adapter

config BACKPORT_RTW88_8822BS
	tristate "Realtek 8822BS SDIO wireless network adapter"
	depends on !RTW88_8822BS
	depends on MMC
	select BACKPORT_RTW88_CORE
	select BACKPORT_RTW88_SDIO
	select BACKPORT_RTW88_8822B
	help
	  Select this option will enable support for 8822BS chipset

	  802.11ac SDIO wireless network adapter

config BACKPORT_RTW88_8822BU
	tristate "Realtek 8822BU USB wireless network adapter"
	depends on !RTW88_8822BU
	depends on USB
	select BACKPORT_RTW88_CORE
	select BACKPORT_RTW88_USB
	select BACKPORT_RTW88_8822B
	help
	  Select this option will enable support for 8822BU chipset

	  802.11ac USB wireless network adapter

config BACKPORT_RTW88_8822CE
	tristate "Realtek 8822CE PCI wireless network adapter"
	depends on !RTW88_8822CE
	depends on PCI
	select BACKPORT_RTW88_CORE
	select BACKPORT_RTW88_PCI
	select BACKPORT_RTW88_8822C
	help
	  Select this option will enable support for 8822CE chipset

	  802.11ac PCIe wireless network adapter

config BACKPORT_RTW88_8822CS
	tristate "Realtek 8822CS SDIO wireless network adapter"
	depends on !RTW88_8822CS
	depends on MMC
	select BACKPORT_RTW88_CORE
	select BACKPORT_RTW88_SDIO
	select BACKPORT_RTW88_8822C
	help
	  Select this option will enable support for 8822CS chipset

	  802.11ac SDIO wireless network adapter

config BACKPORT_RTW88_8822CU
	tristate "Realtek 8822CU USB wireless network adapter"
	depends on !RTW88_8822CU
	depends on USB
	select BACKPORT_RTW88_CORE
	select BACKPORT_RTW88_USB
	select BACKPORT_RTW88_8822C
	help
	  Select this option will enable support for 8822CU chipset

	  802.11ac USB wireless network adapter

config BACKPORT_RTW88_8723DE
	tristate "Realtek 8723DE PCI wireless network adapter"
	depends on !RTW88_8723DE
	depends on PCI
	select BACKPORT_RTW88_CORE
	select BACKPORT_RTW88_PCI
	select BACKPORT_RTW88_8723D
	help
	  Select this option will enable support for 8723DE chipset

	  802.11n PCIe wireless network adapter

config BACKPORT_RTW88_8723DS
	tristate "Realtek 8723DS SDIO wireless network adapter"
	depends on !RTW88_8723DS
	depends on MMC
	select BACKPORT_RTW88_CORE
	select BACKPORT_RTW88_SDIO
	select BACKPORT_RTW88_8723D
	help
	  Select this option will enable support for 8723DS chipset

	  802.11n SDIO wireless network adapter

config BACKPORT_RTW88_8723CS
	tristate "Realtek 8723CS SDIO wireless network adapter"
	depends on !RTW88_8723CS
	depends on MMC
	select BACKPORT_RTW88_CORE
	select BACKPORT_RTW88_SDIO
	select BACKPORT_RTW88_8703B
	help
	  Select this option to enable support for 8723CS chipset (EXPERIMENTAL)

	  This module adds support for the 8723CS 802.11n SDIO
	  wireless network adapter.

	  If you choose to build a module, it'll be called rtw88_8723cs.

config BACKPORT_RTW88_8723DU
	tristate "Realtek 8723DU USB wireless network adapter"
	depends on !RTW88_8723DU
	depends on USB
	select BACKPORT_RTW88_CORE
	select BACKPORT_RTW88_USB
	select BACKPORT_RTW88_8723D
	help
	  Select this option will enable support for 8723DU chipset

	  802.11n USB wireless network adapter

config BACKPORT_RTW88_8821CE
	tristate "Realtek 8821CE PCI wireless network adapter"
	depends on !RTW88_8821CE
	depends on PCI
	select BACKPORT_RTW88_CORE
	select BACKPORT_RTW88_PCI
	select BACKPORT_RTW88_8821C
	help
	  Select this option will enable support for 8821CE chipset

	  802.11ac PCIe wireless network adapter

config BACKPORT_RTW88_8821CS
	tristate "Realtek 8821CS SDIO wireless network adapter"
	depends on !RTW88_8821CS
	depends on MMC
	select BACKPORT_RTW88_CORE
	select BACKPORT_RTW88_SDIO
	select BACKPORT_RTW88_8821C
	help
	  Select this option will enable support for 8821CS chipset

	  802.11ac SDIO wireless network adapter

config BACKPORT_RTW88_8821CU
	tristate "Realtek 8821CU USB wireless network adapter"
	depends on !RTW88_8821CU
	depends on USB
	select BACKPORT_RTW88_CORE
	select BACKPORT_RTW88_USB
	select BACKPORT_RTW88_8821C
	help
	  Select this option will enable support for 8821CU chipset

	  802.11ac USB wireless network adapter

config BACKPORT_RTW88_8821AU
	tristate "Realtek 8821AU/8811AU USB wireless network adapter"
	depends on !RTW88_8821AU
	depends on USB
	select BACKPORT_RTW88_CORE
	select BACKPORT_RTW88_USB
	select BACKPORT_RTW88_8821A
	help
	  Select this option will enable support for 8821AU and 8811AU chipset

	  802.11ac USB wireless network adapter

config BACKPORT_RTW88_8812AU
	tristate "Realtek 8812AU USB wireless network adapter"
	depends on !RTW88_8812AU
	depends on USB
	select BACKPORT_RTW88_CORE
	select BACKPORT_RTW88_USB
	select BACKPORT_RTW88_8812A
	help
	  Select this option will enable support for 8812AU chipset

	  802.11ac USB wireless network adapter

config BACKPORT_RTW88_DEBUG
	bool "Realtek rtw88 debug support"
	depends on !RTW88_DEBUG
	depends on BACKPORT_RTW88_CORE
	help
	  Enable debug support

	  If unsure, say Y to simplify debug problems

config BACKPORT_RTW88_DEBUGFS
	bool "Realtek rtw88 debugfs support"
	depends on !RTW88_DEBUGFS
	depends on BACKPORT_RTW88_CORE
	help
	  Enable debug support

	  If unsure, say Y to simplify debug problems

config BACKPORT_RTW88_LEDS
	bool
	depends on !RTW88_LEDS
	depends on LEDS_CLASS=y || LEDS_CLASS=BACKPORT_MAC80211
	default y

endif
```

## backports/drivers/soc/qcom/Kconfig
```kconfig
# SPDX-License-Identifier: GPL-2.0-only
#
# QCOM Soc drivers
#
menu "Qualcomm SoC drivers"

config BACKPORT_QCOM_AOSS_QMP
	depends on n
	tristate "Qualcomm AOSS Driver"
	depends on !QCOM_AOSS_QMP
	depends on ARCH_QCOM || COMPILE_TEST
	depends on MAILBOX
	depends on COMMON_CLK && PM
	depends on PM_GENERIC_DOMAINS
	help
	  This driver provides the means of communicating with and controlling
	  the low-power state for resources related to the remoteproc
	  subsystems as well as controlling the debug clocks exposed by the Always On
	  Subsystem (AOSS) using Qualcomm Messaging Protocol (QMP).

config BACKPORT_QCOM_COMMAND_DB
	depends on n
	tristate "Qualcomm Command DB"
	depends on !QCOM_COMMAND_DB
	depends on ARCH_QCOM || COMPILE_TEST
	depends on OF_RESERVED_MEM
	help
	  Command DB queries shared memory by key string for shared system
	  resources. Platform drivers that require to set state of a shared
	  resource on a RPM-hardened platform must use this database to get
	  SoC specific identifier and information for the shared resources.

config BACKPORT_QCOM_CPR
	depends on n
	tristate "QCOM Core Power Reduction (CPR) support"
	depends on !QCOM_CPR
	depends on ARCH_QCOM && HAS_IOMEM
	depends on PM_OPP
	depends on REGMAP
	help
	  Say Y here to enable support for the CPR hardware found on Qualcomm
	  SoCs like QCS404.

	  This driver populates CPU OPPs tables and makes adjustments to the
	  tables based on feedback from the CPR hardware. If you want to do
	  CPUfrequency scaling say Y here.

	  To compile this driver as a module, choose M here: the module will
	  be called qcom-cpr

config BACKPORT_QCOM_GENI_SE
	depends on n
	tristate "QCOM GENI Serial Engine Driver"
	depends on !QCOM_GENI_SE
	depends on ARCH_QCOM || COMPILE_TEST
	help
	  This driver is used to manage Generic Interface (GENI) firmware based
	  Qualcomm Technologies, Inc. Universal Peripheral (QUP) Wrapper. This
	  driver is also used to manage the common aspects of multiple Serial
	  Engines present in the QUP.

config BACKPORT_QCOM_GSBI
	depends on n
	tristate "QCOM General Serial Bus Interface"
	depends on !QCOM_GSBI
	depends on ARCH_QCOM || COMPILE_TEST
	depends on MFD_SYSCON
	help
	  Say y here to enable GSBI support.  The GSBI provides control
	  functions for connecting the underlying serial UART, SPI, and I2C
	  devices to the output pins.

config BACKPORT_QCOM_LLCC
	depends on n
	tristate "Qualcomm Technologies, Inc. LLCC driver"
	depends on !QCOM_LLCC
	depends on ARCH_QCOM || COMPILE_TEST
	depends on REGMAP_MMIO
	help
	  Qualcomm Technologies, Inc. platform specific
	  Last Level Cache Controller(LLCC) driver for platforms such as,
	  SDM845. This provides interfaces to clients that use the LLCC.
	  Say yes here to enable LLCC slice driver.

config BACKPORT_QCOM_KRYO_L2_ACCESSORS
	depends on n
	bool
	depends on !QCOM_KRYO_L2_ACCESSORS
	depends on ARCH_QCOM && ARM64 || COMPILE_TEST

config BACKPORT_QCOM_MDT_LOADER
	depends on n
	tristate
	depends on !QCOM_MDT_LOADER
	depends on QCOM_SCM

config BACKPORT_QCOM_OCMEM
	depends on n
	tristate "Qualcomm On Chip Memory (OCMEM) driver"
	depends on !QCOM_OCMEM
	depends on ARCH_QCOM
	depends on QCOM_SCM
	help
	  The On Chip Memory (OCMEM) allocator allows various clients to
	  allocate memory from OCMEM based on performance, latency and power
	  requirements. This is typically used by the GPU, camera/video, and
	  audio components on some Snapdragon SoCs.

config BACKPORT_QCOM_PDR_HELPERS
	depends on n
	tristate
	depends on !QCOM_PDR_HELPERS
	select BACKPORT_QCOM_QMI_HELPERS

config BACKPORT_QCOM_QMI_HELPERS
	tristate
	depends on !QCOM_QMI_HELPERS
	depends on NET

config BACKPORT_QCOM_RMTFS_MEM
	depends on n
	tristate "Qualcomm Remote Filesystem memory driver"
	depends on !QCOM_RMTFS_MEM
	depends on ARCH_QCOM
	depends on QCOM_SCM
	help
	  The Qualcomm remote filesystem memory driver is used for allocating
	  and exposing regions of shared memory with remote processors for the
	  purpose of exchanging sector-data between the remote filesystem
	  service and its clients.

	  Say y here if you intend to boot the modem remoteproc.

config BACKPORT_QCOM_RPMH
	tristate "Qualcomm RPM-Hardened (RPMH) Communication"
	depends on !QCOM_RPMH
	depends on ARCH_QCOM || COMPILE_TEST
	depends on (QCOM_COMMAND_DB || !QCOM_COMMAND_DB)
	help
	  Support for communication with the hardened-RPM blocks in
	  Qualcomm Technologies Inc (QTI) SoCs. RPMH communication uses an
	  internal bus to transmit state requests for shared resources. A set
	  of hardware components aggregate requests for these resources and
	  help apply the aggregated state on the resource.

config BACKPORT_QCOM_RPMHPD
	depends on n
	tristate "Qualcomm RPMh Power domain driver"
	depends on !QCOM_RPMHPD
	depends on QCOM_RPMH && BACKPORT_QCOM_COMMAND_DB
	help
	  QCOM RPMh Power domain driver to support power-domains with
	  performance states. The driver communicates a performance state
	  value to RPMh which then translates it into corresponding voltage
	  for the voltage rail.

config BACKPORT_QCOM_RPMPD
	depends on n
	tristate "Qualcomm RPM Power domain driver"
	depends on !QCOM_RPMPD
	depends on PM
	depends on BACKPORT_QCOM_SMD_RPM
	help
	  QCOM RPM Power domain driver to support power-domains with
	  performance states. The driver communicates a performance state
	  value to RPM which then translates it into corresponding voltage
	  for the voltage rail.

config BACKPORT_QCOM_SMEM
	depends on n
	tristate "Qualcomm Shared Memory Manager (SMEM)"
	depends on !QCOM_SMEM
	depends on ARCH_QCOM || COMPILE_TEST
	depends on HWSPINLOCK
	help
	  Say y here to enable support for the Qualcomm Shared Memory Manager.
	  The driver provides an interface to items in a heap shared among all
	  processors in a Qualcomm platform.

config BACKPORT_QCOM_SMD_RPM
	depends on n
	tristate "Qualcomm Resource Power Manager (RPM) over SMD"
	depends on !QCOM_SMD_RPM
	depends on ARCH_QCOM || COMPILE_TEST
	depends on RPMSG
	help
	  If you say yes to this option, support will be included for the
	  Resource Power Manager system found in the Qualcomm 8974 based
	  devices.

	  This is required to access many regulators, clocks and bus
	  frequencies controlled by the RPM on these devices.

	  Say M here if you want to include support for the Qualcomm RPM as a
	  module. This will build a module called "qcom-smd-rpm".

config BACKPORT_QCOM_SMEM_STATE
	depends on n
	bool
	depends on !QCOM_SMEM_STATE

config BACKPORT_QCOM_SMP2P
	depends on n
	tristate "Qualcomm Shared Memory Point to Point support"
	depends on !QCOM_SMP2P
	depends on MAILBOX
	depends on BACKPORT_QCOM_SMEM
	select BACKPORT_QCOM_SMEM_STATE
	depends on IRQ_DOMAIN
	help
	  Say yes here to support the Qualcomm Shared Memory Point to Point
	  protocol.

config BACKPORT_QCOM_SMSM
	depends on n
	tristate "Qualcomm Shared Memory State Machine"
	depends on !QCOM_SMSM
	depends on BACKPORT_QCOM_SMEM
	select BACKPORT_QCOM_SMEM_STATE
	depends on IRQ_DOMAIN
	help
	  Say yes here to support the Qualcomm Shared Memory State Machine.
	  The state machine is represented by bits in shared memory.

config BACKPORT_QCOM_SOCINFO
	depends on n
	tristate "Qualcomm socinfo driver"
	depends on !QCOM_SOCINFO
	depends on BACKPORT_QCOM_SMEM
	depends on SOC_BUS
	help
	 Say yes here to support the Qualcomm socinfo driver, providing
	 information about the SoC to user space.

config BACKPORT_QCOM_WCNSS_CTRL
	depends on n
	tristate "Qualcomm WCNSS control driver"
	depends on !QCOM_WCNSS_CTRL
	depends on ARCH_QCOM || COMPILE_TEST
	depends on RPMSG
	help
	  Client driver for the WCNSS_CTRL SMD channel, used to download nv
	  firmware to a newly booted WCNSS chip.

config BACKPORT_QCOM_APR
	depends on n
	tristate "Qualcomm APR Bus (Asynchronous Packet Router)"
	depends on !QCOM_APR
	depends on ARCH_QCOM || COMPILE_TEST
	depends on RPMSG
	depends on NET
	select BACKPORT_QCOM_PDR_HELPERS
	help
	  Enable APR IPC protocol support between
	  application processor and QDSP6. APR is
	  used by audio driver to configure QDSP6
	  ASM, ADM and AFE modules.
endmenu
```
