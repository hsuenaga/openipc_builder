## backports/Kconfig
```kconfig
config BACKPORT_INTEGRATE
	bool
	def_bool y

config BACKPORT_DIR
	string
	default "backports/"

config BACKPORT_VERSION
	string
	default "v5.15.162-1-0-g9fa1c65c"

config BACKPORT_KERNEL_VERSION
	string
	default "v5.15.162-0-gf45bea23c39c"

config BACKPORT_KERNEL_NAME
	string
	default "Linux"

menuconfig BACKPORT_LINUX
	bool "Backport Linux v5.15.162-0-gf45bea23c39c (backports v5.15.162-1-0-g9fa1c65c)"
	default n
	---help---
	  Enabling this will let give you the opportunity to use features and
	  drivers backported from Linux v5.15.162-0-gf45bea23c39c
	  on the kernel your are using. This is experimental and you should
	  say no unless you'd like to help test things or want to help debug
	  this should we run into any issues.

if BACKPORT_LINUX

source "$BACKPORT_DIR/Kconfig.versions"
source "$BACKPORT_DIR/Kconfig.sources"
# source "$BACKPORT_DIR/Kconfig.local"

endif # BACKPORT_LINUX
```

## backports/compat/Kconfig
```kconfig
#
# backport Kconfig
#
# Some options are user-selectable ("BPAUTO_USERSEL_*")
#
# Most options, however, follow a few different schemes:
#
# A) An option that is selected by drivers ("select FOO") will be
#    changed to "select BPAUTO_FOO" (if the option BPAUTO_FOO
#    exists). The option BPAUTO_FOO then controls setting of the
#    BPAUTO_BUILD_FOO option, which is a module, like this:
#
# config BPAUTO_BUILD_FOO
#	tristate
#	# or bool
#
#	# not possible on kernel < X.Y, build will fail if any
#	# drivers are allowed to build on kernels < X.Y
#	depends on KERNEL_X_Y
#
#	# don't build the backport code if FOO is in the kernel
#	# already, but only if the kernel version is also >= X.Z;
#	# this is an example of backporting where the version of
#	# the FOO subsystem that we need is only available from
#	# kernel version X.Z
#	depends on !FOO || KERNEL_X_Z
#
#	# build if driver needs it (it selects BPAUTO_FOO)
#	default m if BPAUTO_FOO
#
#	# or for build-testing (BPAUTO_USERSEL_BUILD_ALL is enabled)
#	default m if BACKPORT_BPAUTO_USERSEL_BUILD_ALL
#
# config BPAUTO_FOO
#	bool
#
# This only works as-is if the kernel code is usable on any version,
# otherwise the "&& !FOO" part needs to be different.
#
#
# B) An option for code always present on some kernels (e.g. KFIFO).
#    This simply depends on/sets the default based on the version:
#
# config BPAUTO_BUILD_KFIFO
#	def_bool y
#	depends on KERNEL_2_6_36
#
#
# C) similarly, a kconfig symbol for an option, e.g.
#    BPAUTO_OPTION_SOME_FIX (no examples provided) check git log
#
#
# Variations are obviously possible.
#

config BACKPORT_BP_MODULES
	#option modules
	depends on !BP_MODULES
	bool
	default MODULES

	help
	This symbol is necessary for the newer kconf tool, it looks
	for the "option modules" to control the 'm' state.

config BACKPORT_BPAUTO_BUILD_NLATTR
	def_bool y
	depends on !BPAUTO_BUILD_NLATTR
	depends on KERNEL_5_2
	#c-file lib/nlattr.c

config BACKPORT_BPAUTO_USERSEL_BUILD_ALL
	bool "Build all compat code"
	depends on !BPAUTO_USERSEL_BUILD_ALL
	help
	  This option selects all the compat code options
	  that would otherwise only be selected by drivers.

	  It's only really useful for compat testing, so
	  you probably shouldn't enable it.

config BACKPORT_BPAUTO_WANT_DEV_COREDUMP
	bool
	depends on !BPAUTO_WANT_DEV_COREDUMP

config BACKPORT_BPAUTO_RHASHTABLE
	bool
	depends on !BPAUTO_RHASHTABLE
	# current API of rhashtable was introduced in version 4.9
	# (the one including rhltable)
	depends on KERNEL_4_9
	# not very nice - but better than always having it
	default y if BACKPORTED_MAC80211
	#h-file linux/rhashtable.h
	#h-file linux/rhashtable-types.h
	#c-file lib/rhashtable.c

config BACKPORT_BPAUTO_BUCKET_LOCKS
	bool
	depends on !BPAUTO_BUCKET_LOCKS
	# the API of bucket_locks that we need was introduced in version 4.16
	depends on KERNEL_4_16
	default y if BACKPORT_BPAUTO_RHASHTABLE
	#c-file lib/bucket_locks.c

config BACKPORT_BPAUTO_REFCOUNT
	bool
	depends on !BPAUTO_REFCOUNT
	default y
	depends on KERNEL_4_11
	#h-file linux/refcount.h
	#c-file lib/refcount.c

config BACKPORT_BPAUTO_SYSTEM_DATA_VERIFICATION
	bool
	depends on !BPAUTO_SYSTEM_DATA_VERIFICATION

config BACKPORT_BPAUTO_BUILD_SYSTEM_DATA_VERIFICATION
	bool
	depends on !BPAUTO_BUILD_SYSTEM_DATA_VERIFICATION
	default y if BACKPORT_BPAUTO_SYSTEM_DATA_VERIFICATION
	depends on (KERNEL_4_7 || !SYSTEM_DATA_VERIFICATION) && CRYPTO_HASH_INFO
	select BACKPORT_BPAUTO_ASN1_DECODER
	select BACKPORT_BPAUTO_PUBLIC_KEY
	select BACKPORT_BPAUTO_PKCS7
	#h-file linux/oid_registry.h
	#c-file lib/oid_registry.c

config BACKPORT_BPAUTO_PUBLIC_KEY
	bool
	depends on !BPAUTO_PUBLIC_KEY
	#h-file crypto/public_key.h

config BACKPORT_BPAUTO_ASN1_DECODER
	bool
	depends on !BPAUTO_ASN1_DECODER
	#h-file linux/asn1_decoder.h
	#c-file lib/asn1_decoder.c

config BACKPORT_BPAUTO_PKCS7
	bool
	depends on !BPAUTO_PKCS7
	#h-file crypto/pkcs7.h

config BACKPORT_BPAUTO_CRYPTO_LIB_ARC4
	bool
	depends on !BPAUTO_CRYPTO_LIB_ARC4

config BACKPORT_BPAUTO_BUILD_CRYPTO_LIB_ARC4
	bool
	depends on !BPAUTO_BUILD_CRYPTO_LIB_ARC4
	default y if BACKPORT_BPAUTO_CRYPTO_LIB_ARC4
	depends on !(CRYPTO_LIB_ARC4=y || CRYPTO_LIB_ARC4=m)
	#h-file crypto/arc4.h
	#c-file lib/crypto/arc4.c
```

## backports/drivers/bus/mhi/Kconfig
```kconfig
# SPDX-License-Identifier: GPL-2.0
#
# MHI bus
#
# Copyright (c) 2021, Linaro Ltd.
#

source "$BACKPORT_DIR/drivers/bus/mhi/host/Kconfig"
```

## backports/drivers/net/wireless/ath/ath11k/Kconfig
```kconfig
# SPDX-License-Identifier: BSD-3-Clause-Clear
config BACKPORT_ATH11K
	tristate "Qualcomm Technologies 802.11ax chipset support"
	depends on !ATH11K
	depends on BACKPORT_MAC80211 && HAS_DMA
	depends on CRYPTO_MICHAEL_MIC
	select BACKPORT_ATH_COMMON
	select BACKPORT_QCOM_QMI_HELPERS
	help
	  This module adds support for Qualcomm Technologies 802.11ax family of
	  chipsets.

	  If you choose to build a module, it'll be called ath11k.

config BACKPORT_ATH11K_AHB
	tristate "Atheros ath11k AHB support"
	depends on !ATH11K_AHB
	depends on BACKPORT_ATH11K
	depends on REMOTEPROC
	help
	  This module adds support for AHB bus

config BACKPORT_ATH11K_PCI
	tristate "Atheros ath11k PCI support"
	depends on !ATH11K_PCI
	depends on BACKPORT_ATH11K && PCI
	select BACKPORT_MHI_BUS
	select BACKPORT_QRTR
	select BACKPORT_QRTR_MHI
	help
	  This module adds support for PCIE bus

config BACKPORT_ATH11K_DEBUG
	bool "QCA ath11k debugging"
	depends on !ATH11K_DEBUG
	depends on BACKPORT_ATH11K
	help
	  Enables debug support

	  If unsure, say Y to make it easier to debug problems.

config BACKPORT_ATH11K_DEBUGFS
	bool "QCA ath11k debugfs support"
	depends on !ATH11K_DEBUGFS
	depends on ATH11K && DEBUG_FS && BACKPORT_MAC80211_DEBUGFS
	help
	  Enable ath11k debugfs support

	  If unsure, say Y to make it easier to debug problems.

config BACKPORT_ATH11K_TRACING
	bool "ath11k tracing support"
	depends on !ATH11K_TRACING
	depends on BACKPORT_ATH11K && EVENT_TRACING
	help
	  Select this to use ath11k tracing infrastructure.

config BACKPORT_ATH11K_SPECTRAL
	bool "QCA ath11k spectral scan support"
	depends on !ATH11K_SPECTRAL
	depends on BACKPORT_ATH11K_DEBUGFS
	depends on RELAY
	help
	  Enable ath11k spectral scan support

	  Say Y to enable access to the FFT/spectral data via debugfs.
```

## backports/drivers/net/wireless/broadcom/brcm80211/Kconfig
```kconfig
# SPDX-License-Identifier: GPL-2.0-only
config BACKPORT_BRCMUTIL
	tristate
	depends on !BRCMUTIL

config BACKPORT_BRCMSMAC
	tristate "Broadcom IEEE802.11n PCIe SoftMAC WLAN driver"
	depends on !BRCMSMAC
	depends on BACKPORT_BCMA_POSSIBLE
	select BACKPORT_BCMA
	select NEW_LEDS if BACKPORT_BCMA_DRIVER_GPIO
	select LEDS_CLASS if BACKPORT_BCMA_DRIVER_GPIO
	select BACKPORT_BRCMUTIL
	depends on CORDIC
	## disabled to fix recursive dependency instantly.
	#depends on BACKPORT_MAC80211
	#depends on FW_LOADER
	help
	  This module adds support for PCIe wireless adapters based on Broadcom
	  IEEE802.11n SoftMAC chipsets. It also has BACKPORT_WLAN led support, which will
	  be available if you select BACKPORT_BCMA_DRIVER_GPIO. If you choose to build a
	  module, the driver will be called brcmsmac.ko.

source "$BACKPORT_DIR/drivers/net/wireless/broadcom/brcm80211/brcmfmac/Kconfig"

config BACKPORT_BRCM_TRACING
	bool "Broadcom device tracing"
	depends on !BRCM_TRACING
	depends on BACKPORT_BRCMSMAC || BRCMFMAC
	help
	  If you say Y here, the Broadcom wireless drivers will register
	  with ftrace to dump event information into the trace ringbuffer.
	  Tracing can be enabled at runtime to aid in debugging wireless
	  issues. This option adds a small amount of overhead when tracing
	  is disabled. If unsure, say Y to allow developers to better help
	  you when wireless problems occur.

config BACKPORT_BRCMDBG
	bool "Broadcom driver debug functions"
	depends on !BRCMDBG
	depends on BACKPORT_BRCMSMAC || BRCMFMAC
	select WANT_DEV_COREDUMP if BACKPORT_BRCMFMAC
	help
	  Selecting this enables additional code for debug purposes.
```

## backports/drivers/net/wireless/intersil/Kconfig
```kconfig
# SPDX-License-Identifier: GPL-2.0-only
config BACKPORT_WLAN_VENDOR_INTERSIL
	bool "Intersil devices"
	depends on !WLAN_VENDOR_INTERSIL
	default y
	help
	  If you have a wireless card belonging to this class, say Y.

	  Note that the answer to this question doesn't directly affect the
	  kernel: saying N will just cause the configurator to skip all the
	  questions about these cards. If you say Y, you will be asked for
	  your specific card in the following questions.

if BACKPORT_WLAN_VENDOR_INTERSIL

#source "drivers/net/wireless/intersil/hostap/Kconfig"
source "$BACKPORT_DIR/drivers/net/wireless/intersil/orinoco/Kconfig"
source "$BACKPORT_DIR/drivers/net/wireless/intersil/p54/Kconfig"

endif # BACKPORT_WLAN_VENDOR_INTERSIL
```

## backports/drivers/net/wireless/mediatek/mt76/Kconfig
```kconfig
# SPDX-License-Identifier: GPL-2.0-only
config BACKPORT_MT76_CORE
	tristate
	depends on !MT76_CORE

config BACKPORT_MT76_LEDS
	bool
	depends on !MT76_LEDS
	depends on BACKPORT_MT76_CORE
	depends on LEDS_CLASS=y || BACKPORT_MT76_CORE=LEDS_CLASS
	default y

config BACKPORT_MT76_USB
	tristate
	depends on !MT76_USB
	depends on BACKPORT_MT76_CORE

config BACKPORT_MT76_SDIO
	tristate
	depends on !MT76_SDIO
	depends on BACKPORT_MT76_CORE

config BACKPORT_MT76x02_LIB
	tristate
	depends on !MT76x02_LIB
	select BACKPORT_MT76_CORE

config BACKPORT_MT76x02_USB
	tristate
	depends on !MT76x02_USB
	select BACKPORT_MT76_USB

config BACKPORT_MT76_CONNAC_LIB
	tristate
	depends on !MT76_CONNAC_LIB
	select BACKPORT_MT76_CORE

source "$BACKPORT_DIR/drivers/net/wireless/mediatek/mt76/mt76x0/Kconfig"
source "$BACKPORT_DIR/drivers/net/wireless/mediatek/mt76/mt76x2/Kconfig"
source "$BACKPORT_DIR/drivers/net/wireless/mediatek/mt76/mt7603/Kconfig"
source "$BACKPORT_DIR/drivers/net/wireless/mediatek/mt76/mt7615/Kconfig"
source "$BACKPORT_DIR/drivers/net/wireless/mediatek/mt76/mt7915/Kconfig"
source "$BACKPORT_DIR/drivers/net/wireless/mediatek/mt76/mt7921/Kconfig"
```

## backports/drivers/net/wireless/mediatek/mt76/mt7603/Kconfig
```kconfig
# SPDX-License-Identifier: GPL-2.0-only
config BACKPORT_MT7603E
	tristate "MediaTek MT7603E (PCIe) and MT76x8 WLAN support"
	depends on !MT7603E
	select BACKPORT_MT76_CORE
	depends on BACKPORT_MAC80211
	depends on PCI
	help
	  This adds support for MT7603E wireless PCIe devices and the BACKPORT_WLAN core
	  on MT7628/MT7688 SoC devices. This family supports IEEE 802.11n 2x2
	  to 300Mbps PHY rate

	  To compile this driver as a module, choose M here.
```

## backports/drivers/net/wireless/mediatek/mt76/mt7615/Kconfig
```kconfig
# SPDX-License-Identifier: GPL-2.0-only

config BACKPORT_MT7615_COMMON
	tristate
	depends on !MT7615_COMMON
	select BPAUTO_WANT_DEV_COREDUMP
	select BACKPORT_MT76_CONNAC_LIB

config BACKPORT_MT7615E
	tristate "MediaTek MT7615E and MT7663E (PCIe) support"
	depends on !MT7615E
	select BACKPORT_MT7615_COMMON
	depends on BACKPORT_MAC80211
	depends on PCI
	help
	  This adds support for MT7615-based wireless PCIe devices,
	  which support concurrent dual-band operation at both 5GHz
	  and 2.4GHz, IEEE 802.11ac 4x4:4SS 1733Mbps PHY rate, wave2
	  MU-MIMO up to 4 users/group and 160MHz channels.

	  To compile this driver as a module, choose M here.

config BACKPORT_MT7622_WMAC
	bool "MT7622 (SoC) WMAC support"
	depends on !MT7622_WMAC
	depends on BACKPORT_MT7615E
	depends on ARCH_MEDIATEK || COMPILE_TEST
	depends on REGMAP
	default y
	help
	  This adds support for the built-in WMAC on MT7622 SoC devices
	  which has the same feature set as a MT7615, but limited to
	  2.4 GHz only.

config BACKPORT_MT7663_USB_SDIO_COMMON
	tristate
	depends on !MT7663_USB_SDIO_COMMON
	select BACKPORT_MT7615_COMMON

config BACKPORT_MT7663U
	tristate "MediaTek MT7663U (USB) support"
	depends on !MT7663U
	select BACKPORT_MT76_USB
	select BACKPORT_MT7663_USB_SDIO_COMMON
	depends on BACKPORT_MAC80211
	depends on USB
	help
	  This adds support for BACKPORT_MT7663U 802.11ac 2x2:2 wireless devices.

	  To compile this driver as a module, choose M here.

config BACKPORT_MT7663S
	tristate "MediaTek MT7663S (SDIO) support"
	depends on !MT7663S
	select BACKPORT_MT76_SDIO
	select BACKPORT_MT7663_USB_SDIO_COMMON
	depends on BACKPORT_MAC80211
	depends on MMC
	help
	  This adds support for BACKPORT_MT7663S 802.11ac 2x2:2 wireless devices.

	  To compile this driver as a module, choose M here.
```

## backports/drivers/net/wireless/mediatek/mt76/mt76x2/Kconfig
```kconfig
# SPDX-License-Identifier: GPL-2.0-only
config BACKPORT_MT76x2_COMMON
	tristate
	depends on !MT76x2_COMMON
	select BACKPORT_MT76x02_LIB

config BACKPORT_MT76x2E
	tristate "MediaTek MT76x2E (PCIe) support"
	depends on !MT76x2E
	select BACKPORT_MT76x2_COMMON
	depends on BACKPORT_MAC80211
	depends on PCI
	help
	  This adds support for MT7612/MT7602/MT7662-based wireless PCIe
	  devices, which comply with IEEE 802.11ac standards and support
	  2SS to 866Mbit/s PHY rate.

	  To compile this driver as a module, choose M here.

config BACKPORT_MT76x2U
	tristate "MediaTek MT76x2U (USB) support"
	depends on !MT76x2U
	select BACKPORT_MT76x2_COMMON
	select BACKPORT_MT76x02_USB
	depends on BACKPORT_MAC80211
	depends on USB
	help
	  This adds support for MT7612U-based wireless USB 3.0 dongles,
	  which comply with IEEE 802.11ac standards and support 2SS to
	  866Mbit/s PHY rate.

	  To compile this driver as a module, choose M here.
```

## backports/drivers/net/wireless/mediatek/mt76/mt7921/Kconfig
```kconfig
# SPDX-License-Identifier: ISC
config BACKPORT_MT7921E
	tristate "MediaTek MT7921E (PCIe) support"
	depends on !MT7921E
	select BACKPORT_MT76_CONNAC_LIB
	depends on WANT_DEV_COREDUMP
	depends on BACKPORT_MAC80211
	depends on PCI
	help
	  This adds support for BACKPORT_MT7921E 802.11ax 2x2:2SS wireless devices.

	  To compile this driver as a module, choose M here.
```

## backports/drivers/net/wireless/microchip/Kconfig
```kconfig
# SPDX-License-Identifier: GPL-2.0
config BACKPORT_WLAN_VENDOR_MICROCHIP
	bool "Microchip devices"
	depends on !WLAN_VENDOR_MICROCHIP
	default y
	help
	If you have a wireless card belonging to this class, say Y.

	Note that the answer to this question doesn't directly affect the
	kernel: saying N will just cause the configurator to skip all the
	questions about these cards. If you say Y, you will be asked for
	your specific card in the following questions.

if BACKPORT_WLAN_VENDOR_MICROCHIP
source "$BACKPORT_DIR/drivers/net/wireless/microchip/wilc1000/Kconfig"
endif # BACKPORT_WLAN_VENDOR_MICROCHIP
```
